## meta-honeycomb/conf/distro/include/honeycomb-base.inc
```bitbake
require conf/distro/poky.conf

DISTRO = "honeycomb"
DISTRO_NAME = "IOTA honeycombOS"
DISTRO_VERSION = "0.4.0"

MAINTAINER = "Bernardo A. Rodrigues <bernardo.araujo@iota.org>"

GOVERSION = "1.15%"

DISTRO_FEATURES += " \
                   systemd \
                   wifi \
                   pam \
                   polkit \
"

VIRTUAL-RUNTIME_init_manager = "systemd"
DISTRO_FEATURES_BACKFILL_CONSIDERED = "sysvinit"

PACKAGE_CLASSES = "package_deb"

INHERIT += "extrausers"

DENYLIST_usermod = "qemuarm qemuarm64 qemux86 qemux86-64 genericx86 genericx86-64 "
EXTRA_USERS_PARAMS = "${@bb.utils.contains('DENYLIST_usermod', 'MACHINE', 'usermod -P tangleisawesome root;', '', d)}"
```

## meta-honeycomb/conf/layer.conf
```bitbake
# We have a conf and classes directory, add to BBPATH
BBPATH .= ":${LAYERDIR}"

# We have recipes-* directories, add to BBFILES
BBFILES += "${LAYERDIR}/recipes-*/*/*.bb \
            ${LAYERDIR}/recipes-*/*/*.bbappend"

BBFILE_COLLECTIONS += "honeycomb-layer"
BBFILE_PATTERN_honeycomb-layer = "^${LAYERDIR}/"
BBFILE_PRIORITY_honeycomb-layer = "6"

LAYERDEPENDS_honeycomb-layer = "core tangle-layer openembedded-layer meta-python networking-layer webserver"
LAYERSERIES_COMPAT_honeycomb-layer = "dunfell"
```

## meta-tangle/conf/layer.conf
```bitbake
# We have a conf and classes directory, add to BBPATH
BBPATH .= ":${LAYERDIR}"

# We have recipes-* directories, add to BBFILES
BBFILES += "${LAYERDIR}/recipes-*/*/*.bb \
            ${LAYERDIR}/recipes-*/*/*.bbappend"

BBFILE_COLLECTIONS += "tangle-layer"
BBFILE_PATTERN_tangle-layer = "^${LAYERDIR}/"
BBFILE_PRIORITY_tangle-layer = "6"

LAYERDEPENDS_tangle-layer = "core openembedded-layer meta-python networking-layer"
LAYERSERIES_COMPAT_tangle-layer = " dunfell"
```
